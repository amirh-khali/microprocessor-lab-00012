/*
 * program.asm
 *
 *  Created: 2/28/2022 11:55:31 AM
 *   Author: AmirH
 */ 


.include "m32def.inc"

.ORG	0
		RJMP	START
.ORG	OC1Aaddr
		RJMP	OC1

START:	LDI		R16,HIGH(RAMEND)
		OUT		SPH,R16
		LDI		R16,LOW(RAMEND)
		OUT		SPL,R16

		LDI		R16,0xFF
		OUT		DDRC,R16		;PORTC output
		OUT		DDRD,R16		;PORTD output

		OUT		PORTA,R16		
		LDI		R16,0x00
		OUT		DDRA,R16		;PORTA input
		OUT		DDRB,R16		;PORTB input


BEGIN:	
		IN		R16,PINA
		CPI 	R16,0
		BREQ 	BEGINREVERSE
		LDI		R20,0			
		LDI		R21,0			
		LDI		R22,0			
		LDI     R23,0			
		
		RJMP	TIMER

BEGINREVERSE:
		LDI		R20,9			
		LDI		R21,9			
		LDI		R22,9			
		LDI     R23,9
					
		RJMP	TIMER

TIMER:	
		LDI		R25, 0X00
		OUT		TCCR1A, R25
		
		LDI		R25, 0X0C
		OUT		TCCR1B, R25

		LDI		R25, 0X7A
		OUT		OCR1AH, R25
		
		LDI		R25, 0X12
		OUT		OCR1AL, R25
		
		LDI		R25, 0X12
		OUT		TIMSK, R25
		
		SEI


DISPLAY: ;Display Number
		LDI		R16,0b1110	
		OUT		PORTD,R16
		MOV		R16,R23
		CALL	CONVERT
		OUT		PORTC,R16
		CALL	DELAY

		LDI		R16,0b1101	 
		OUT		PORTD,R16
		MOV		R16,R22
		CALL	CONVERT
		OUT		PORTC,R16
		CALL	DELAY
		

		LDI		R16,0b1011	
		OUT		PORTD,R16
		MOV		R16,R21
		CALL	CONVERT
		OUT		PORTC,R16
		CALL	DELAY

		LDI		R16,0b0111	
		OUT		PORTD,R16
		MOV		R16,R20
		CALL	CONVERT
		OUT		PORTC,R16
		CALL	DELAY

		RJMP	DISPLAY


DELAY:	LDI		R17,0xFF
L1:		LDI		R18,0x01
L2:		LDI		R19,0x01
L3:		DEC		R19
		BRNE	L3
		DEC		R18
		BRNE	L2
		DEC		R17
		BRNE	L1
		RET

OC1:
		IN		R16,PINA
		CPI 	R16,0
		BREQ 	REVERSE0
		RJMP	FORWARD0

FORWARD0:		
		CPI 	R20,0x09
		BREQ 	FORWARD1
		INC 	R20
		RETI

FORWARD1:		
		LDI 	R20,0x00
		CPI 	R21,0x09
		BREQ 	FORWARD2
		INC 	R21
		RETI

FORWARD2:		
		LDI 	R21,0x00
		CPI 	R22,0x09
		BREQ 	FORWARD3
		INC 	R22
		RETI

FORWARD3: 	
		LDI 	R22,0x00
		CPI 	R23,0x09
		BREQ 	FORWARD4
		INC 	R23
		RETI

FORWARD4: 	
		LDI 	R23,0x00
		RETI
		

REVERSE0: 	
		CPI 	R20,0x00
		BREQ 	REVERSE1
		DEC		R20
		RETI


REVERSE1:		
		LDI 	R20,0x09
		CPI 	R21,0x00
		BREQ 	REVERSE2
		DEC 	R21
		RETI

REVERSE2:		
		LDI 	R21,0x09
		CPI 	R22,0x00
		BREQ 	REVERSE3
		DEC 	R22
		RETI

REVERSE3: 	
		LDI 	R22,0x09
		CPI 	R23,0x00
		BREQ 	REVERSE4
		DEC 	R22
		RETI

REVERSE4:	
		LDI 	R23,0x09
		RETI


CONVERT:				;converts a digit to 7seg code 
		CPI		R16,0
		BRNE	C1
		LDI		R16,0x3F
		RET
C1:		CPI		R16,1
		BRNE	C2
		LDI		R16,0x06
		RET
C2:		CPI		R16,2
		BRNE	C3
		LDI		R16,0x5B
		RET
C3:		CPI		R16,3
		BRNE	C4
		LDI		R16,0x4F
		RET
C4:		CPI		R16,4
		BRNE	C5
		LDI		R16,0x66
		RET
C5:		CPI		R16,5
		BRNE	C6
		LDI		R16,0x6D
		RET
C6:		CPI		R16,6
		BRNE	C7
		LDI		R16,0x7D
		RET
C7:		CPI		R16,7
		BRNE	C8
		LDI		R16,0x07
		RET
C8:		CPI		R16,8
		BRNE	C9
		LDI		R16,0x7F
		RET
C9:		CPI		R16,9
		BRNE	C10
		LDI		R16,0x6F
C10:	RET
